## sdkconfig.defaults
```kconfig
# Array Control Firmware - Default SDK Configuration
# Copy this to sdkconfig.defaults or merge with existing sdkconfig

# ============================================================================
# ESP32-S3 Specific
# ============================================================================
CONFIG_IDF_TARGET="esp32s3"

# ============================================================================
# PSRAM Configuration (REQUIRED for continuous mode)
# ============================================================================
CONFIG_SPIRAM=y
CONFIG_SPIRAM_MODE_OCT=y
CONFIG_SPIRAM_TYPE_AUTO=y
CONFIG_SPIRAM_SPEED_80M=y
CONFIG_SPIRAM_USE_MALLOC=y
CONFIG_SPIRAM_ALLOW_BSS_SEG_EXTERNAL_MEMORY=y
CONFIG_SPIRAM_ALLOW_NOINIT_SEG_EXTERNAL_MEMORY=y
CONFIG_SPIRAM_MALLOC_ALWAYSINTERNAL=16384

# ============================================================================
# ADC Configuration
# ============================================================================
CONFIG_ADC_CONTINUOUS_ISR_IRAM_SAFE=y
CONFIG_ADC_DISABLE_DAC_OUTPUT=y

# ============================================================================
# DMA Configuration
# ============================================================================
CONFIG_GDMA_CTRL_FUNC_IN_IRAM=y
CONFIG_GDMA_ISR_IRAM_SAFE=y

# ============================================================================
# FreeRTOS Configuration
# ============================================================================
CONFIG_FREERTOS_HZ=1000
CONFIG_FREERTOS_ISR_STACK_SIZE=1536
CONFIG_FREERTOS_PLACE_FUNCTIONS_INTO_FLASH=y

# ============================================================================
# Memory Configuration
# ============================================================================
CONFIG_MAIN_TASK_STACK_SIZE=8192
CONFIG_ESP_MAIN_TASK_AFFINITY_CPU0=y

# ============================================================================
# USB CDC Configuration
# ============================================================================
CONFIG_USB_CDC_ENABLED=y

# ============================================================================
# Logging
# ============================================================================
CONFIG_LOG_DEFAULT_LEVEL_INFO=y
CONFIG_LOG_COLORS=y

# ============================================================================
# Compiler Options
# ============================================================================
CONFIG_COMPILER_OPTIMIZATION_PERF=y
CONFIG_COMPILER_STACK_CHECK_MODE_NONE=y
```

## sdkconfig.defaults.dma
```kconfig
# DMA Acquisition Build Configuration
# Copy these settings to your sdkconfig or sdkconfig.defaults

# Enable PSRAM (required for continuous mode)
CONFIG_SPIRAM=y
CONFIG_SPIRAM_MODE_QUAD=y
CONFIG_SPIRAM_TYPE_AUTO=y
CONFIG_SPIRAM_SIZE=-1
CONFIG_SPIRAM_SPEED_80M=y
CONFIG_SPIRAM_MEMTEST=y
CONFIG_SPIRAM_CACHE_WORKAROUND=y
CONFIG_SPIRAM_BANKSWITCH_ENABLE=y
CONFIG_SPIRAM_BANKSWITCH_RESERVE=8
CONFIG_SPIRAM_MALLOC_ALWAYSINTERNAL=16384
CONFIG_SPIRAM_TRY_ALLOCATE_WIFI_LWIP=y
CONFIG_SPIRAM_MALLOC_RESERVE_INTERNAL=32768

# ADC configuration
CONFIG_ADC_DISABLE_DAC=y

# DMA configuration
CONFIG_GDMA_CTRL_FUNC_IN_IRAM=y
CONFIG_GDMA_ISR_IRAM_SAFE=y

# FreeRTOS optimizations for DMA
CONFIG_FREERTOS_HZ=1000
CONFIG_FREERTOS_ISR_STACK_SIZE=1536

# Increase main task stack for DMA operations
CONFIG_ESP_MAIN_TASK_STACK_SIZE=8192

# USB CDC configuration
CONFIG_USB_CDC_ENABLED=y

# Increase buffer sizes
CONFIG_USB_CDC_RX_BUFSIZE=512
CONFIG_USB_CDC_TX_BUFSIZE=512
```
